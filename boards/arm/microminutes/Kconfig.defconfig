## boards/arm/microminutes/Kconfig.defconfig
```kconfig
# Copyright (c) 2024 Nordic Semiconductor ASA
# SPDX-License-Identifier: Apache-2.0

if BOARD_MICROMINUTES

config BOARD
	default "microminutes"

config BT_CTLR
   default BT


endif
```

## boards/arm/microminutes/microminutes_defconfig
```kconfig
# Copyright (c) 2024 Nordic Semiconductor ASA
# SPDX-License-Identifier: Apache-2.0

CONFIG_SOC_SERIES_NRF52X=y
CONFIG_SOC_NRF52810_QFAA=y
CONFIG_BOARD_MICROMINUTES=y

# Enable MPU
CONFIG_ARM_MPU=y

# Enable hardware stack protection
CONFIG_HW_STACK_PROTECTION=y

# Enable GPIO
CONFIG_GPIO=y

# Enable 32KHz internal oscillator sine I don't have an external oscillator
CONFIG_CLOCK_CONTROL_NRF_K32SRC_RC=y
CONFIG_CLOCK_CONTROL_NRF_K32SRC_RC_CALIBRATION=y

# Enable I2C
CONFIG_I2C=y

# RTC Emulation
CONFIG_RTC=y
CONFIG_RTC_EMUL=y
CONFIG_RTC_ALARM=y
CONFIG_RTC_CALIBRATION=y
```

## boards/arm/ouroboros_v0_1_nrf52810/Kconfig.board
```kconfig
# Copyright (c) 2024 Nordic Semiconductor ASA
# SPDX-License-Identifier: Apache-2.0

config BOARD_OUROBOROS_V0_1_NRF52810
	bool "Ouroboros V0_1 nRF52810"
	depends on SOC_NRF52810_QFAA
```

## boards/arm/ouroboros_v0_1_nrf52810/Kconfig.defconfig
```kconfig
# Copyright (c) 2024 Nordic Semiconductor ASA
# SPDX-License-Identifier: Apache-2.0

if BOARD_OUROBOROS_V0_1_NRF52810

config BOARD
	default "ouroboros_v0_1_nrf52810"

config BT_CTLR
   default BT


endif
```

## build/Kconfig/Kconfig.shield
```kconfig
osource "c:/ouroboros-dev/boards/shields/*/Kconfig.shield"
osource "C:/ncs/v2.6.1/nrf/boards/shields/*/Kconfig.shield"
```

## build/Kconfig/Kconfig.shield.defconfig
```kconfig
osource "c:/ouroboros-dev/boards/shields/*/Kconfig.defconfig"
osource "C:/ncs/v2.6.1/nrf/boards/shields/*/Kconfig.defconfig"
```

## build_2/Kconfig/Kconfig.shield
```kconfig
osource "c:/ouroboros-dev/boards/shields/*/Kconfig.shield"
osource "c:/ouroboros-dev/board_programs/blinky_1/boards/shields/*/Kconfig.shield"
osource "c:/ncs/v2.6.1/zephyr/samples/bluetooth/beacon/boards/shields/*/Kconfig.shield"
osource "c:/ncs/v2.6.1/nrf/samples/bluetooth/peripheral_uart/boards/shields/*/Kconfig.shield"
osource "C:/ncs/v2.6.1/nrf/boards/shields/*/Kconfig.shield"
```

## build_2/Kconfig/Kconfig.shield.defconfig
```kconfig
osource "c:/ouroboros-dev/boards/shields/*/Kconfig.defconfig"
osource "c:/ouroboros-dev/board_programs/blinky_1/boards/shields/*/Kconfig.defconfig"
osource "c:/ncs/v2.6.1/zephyr/samples/bluetooth/beacon/boards/shields/*/Kconfig.defconfig"
osource "c:/ncs/v2.6.1/nrf/samples/bluetooth/peripheral_uart/boards/shields/*/Kconfig.defconfig"
osource "C:/ncs/v2.6.1/nrf/boards/shields/*/Kconfig.defconfig"
```
